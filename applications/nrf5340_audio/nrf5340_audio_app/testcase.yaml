## applications/nrf5340_audio/nrf5340_audio_app/testcase.yaml
```yaml
tests:
  test_nrf5340_audio_core_app_debug:
    build_only: true
    platform_allow: nrf5340_dk_nrf5340_cpuapp nrf5340_audio_dk_nrf5340_cpuapp
    tags: nrf5340_audio_core_app_debug
    extra_args: "CMAKE_BUILD_TYPE=DEBUG"
  test_nrf5340_audio_core_app_release:
    build_only: true
    platform_allow: nrf5340_dk_nrf5340_cpuapp nrf5340_audio_dk_nrf5340_cpuapp
    tags: nrf5340_audio_core_app_release
    extra_args: "CMAKE_BUILD_TYPE=RELEASE"
```

## lib/contin_array/Kconfig
```kconfig
# Continuous Array creator
#
# Copyright (c) 2022 Nordic Semiconductor
#
# SPDX-License-Identifier: LicenseRef-Nordic-5-Clause
#

module = CONTIN_ARRAY
module-str = Continuous array
source "${ZEPHYR_BASE}/subsys/logging/Kconfig.template.log_config"
```

## tests/nrf5340_audio/tmp_cap/testcase.yaml
```yaml
tests:
  nrf5340_audio.tmp_cap_test:
    platform_allow: qemu_cortex_m3
    integration_platforms:
      - qemu_cortex_m3
    tags: nrf5340_audio_unit_tests
```
