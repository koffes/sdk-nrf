## CMakeLists.txt
```
#
# Copyright (c) 2022 Nordic Semiconductor ASA
#
# SPDX-License-Identifier: LicenseRef-Nordic-5-Clause
#

#cmake_minimum_required(VERSION 3.20.0)
#
#find_package(Zephyr REQUIRED HINTS $ENV{ZEPHYR_BASE})
#project(tmp_cap)
#
#FILE(GLOB app_sources src/*.c)
##target_sources(app PRIVATE ${ZEPHYR_NRF_MODULE_DIR}/applications/nrf5340_audio/src/bluetooth/tmp_cap.c)
##${ZEPHYR_NRF_MODULE_DIR}/applications/nrf5340_audio/src/utils/macros/
#
##target_include_directories(app
##  PRIVATE
##  ${ZEPHYR_NRF_MODULE_DIR}/applications/nrf5340_audio/src/bluetooth/
##  )
#
#target_sources(app
#  PRIVATE main.c
#  )


cmake_minimum_required(VERSION 3.20.0)

find_package(Zephyr REQUIRED HINTS $ENV{ZEPHYR_BASE})
project(NONE)

target_sources(app
  PRIVATE main.c
  )

target_include_directories(app
  PRIVATE
  ${ZEPHYR_NRF_MODULE_DIR}/applications/nrf5340_audio/src/utils/macros/
  )
```

## prj.conf
```kconfig
CONFIG_ZTEST=y
CONFIG_IRQ_OFFLOAD=y
#CONFIG_BT=y
#CONFIG_BT_AUDIO=y
#CONFIG_MAIN_STACK_SIZE=40000
```

## src/main.c
```c
/*
 * Copyright (c) 2018 Nordic Semiconductor ASA
 *
 * SPDX-License-Identifier: LicenseRef-Nordic-5-Clause
 */

#include <zephyr/ztest.h>
#include <zephyr/tc_util.h>

//#include "tmp_cap.h"

void test_push_peek(void)
{
	//int ret;
	//static struct tmp_cap_storage tmp_cap[CONFIG_BT_MAX_CONN];
	//struct bt_codec codec;

	//uint8_t dummy;
	//struct bt_conn *conn = (struct bt_conn*)&dummy;


	//ret = tmp_cap_push(tmp_cap, conn, 2, &codec);
	zassert_equal(0, 0, "tmp_cap_pushed returned an error");
}

void test_main(void)
{
	ztest_test_suite(test_suite_tmp_cap,
		ztest_unit_test(test_push_peek)
	);

	ztest_run_test_suite(test_suite_tmp_cap);
}
```
